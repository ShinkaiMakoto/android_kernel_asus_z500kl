/* Copyright (c) 2015, The Linux Foundation. All rights reserved.
 *
 * This program is free software; you can redistribute it and/or modify
 * it under the terms of the GNU General Public License version 2 and
 * only version 2 as published by the Free Software Foundation.
 *
 * This program is distributed in the hope that it will be useful,
 * but WITHOUT ANY WARRANTY; without even the implied warranty of
 * MERCHANTABILITY or FITNESS FOR A PARTICULAR PURPOSE.  See the
 * GNU General Public License for more details.
 */

&mdss_mdp {
	dsi_auo_nt35523_dualmipi_1536x2048_cmd: qcom,mdss_dsi_auo_nt35523_dualmipi_1536x2048_cmd{
		qcom,mdss-dsi-panel-name =
			"auo nt35523 dualmipi 1536x2048 cmd";
		qcom,mdss-dsi-panel-type = "dsi_cmd_mode";
		qcom,mdss-dsi-panel-framerate = <60>;
		qcom,mdss-dsi-virtual-channel-id = <0>;
		qcom,mdss-dsi-stream = <0>;
		qcom,mdss-dsi-panel-width = <768>;
		qcom,mdss-dsi-panel-height = <2048>;
		qcom,mdss-dsi-h-front-porch = <100>;
		qcom,mdss-dsi-h-back-porch = <100>;
		qcom,mdss-dsi-h-pulse-width = <8>;
		qcom,mdss-dsi-h-sync-skew = <0>;
		qcom,mdss-dsi-v-back-porch = <11>;
		qcom,mdss-dsi-v-front-porch = <15>;
		qcom,mdss-dsi-v-pulse-width = <2>;
		qcom,mdss-pan-physical-width-dimension = <120>;
		qcom,mdss-pan-physical-height-dimension = <160>;
		qcom,mdss-dsi-h-left-border = <0>;
		qcom,mdss-dsi-h-right-border = <0>;
		qcom,mdss-dsi-v-top-border = <0>;
		qcom,mdss-dsi-v-bottom-border = <0>;
		qcom,mdss-dsi-bpp = <24>;
		qcom,mdss-dsi-on-command = [
                        15 01 00 00 00 00 02 53 2c
                        15 01 00 00 00 00 02 51 00
                        15 01 00 00 00 00 02 55 03
                        05 01 00 00 3f 00 01 11
                        05 01 00 00 3f 00 01 29
		];
		qcom,mdss-dsi-on-command-state = "dsi_lp_mode";
		qcom,mdss-dsi-off-command = [15 01 00 00 00 00 02 28 00
			15 01 00 00 64 00 02 10 00];
		qcom,mdss-dsi-off-command-state = "dsi_hs_mode";
		qcom,mdss-dsi-color-order; /* original has no default setting */
		qcom,mdss-dsi-underflow-color = <0xff>;
		qcom,mdss-dsi-border-color = <0>;

		qcom,mdss-dsi-h-sync-pulse = <8>; /* Paddy is 0 , Xutao excel is 8 */
		qcom,mdss-dsi-traffic-mode = "non_burst_sync_event";
		qcom,mdss-dsi-bllp-eof-power-mode;
		qcom,mdss-dsi-bllp-power-mode;
		qcom,mdss-dsi-lane-0-state;
		qcom,mdss-dsi-lane-1-state;
		qcom,mdss-dsi-lane-2-state;
		qcom,mdss-dsi-lane-3-state;
		qcom,mdss-dsi-panel-timings = [c5 2c 1e 00 5a 5c 24 30 25 03 04 00];
		qcom,mdss-dsi-t-clk-post = <0x3>;
		qcom,mdss-dsi-t-clk-pre = <0x25>;

		qcom,mdss-dsi-bl-min-level = <1>;
		qcom,mdss-dsi-bl-max-level = <4095>;
		qcom,mdss-dsi-dma-trigger = "trigger_sw";
		qcom,mdss-dsi-mdp-trigger = "none";
		qcom,mdss-dsi-init-delay-us = <1000>;
		qcom,mdss-dsi-te-dcs-command = <1>;
		qcom,mdss-dsi-wr-mem-start = <0x2c>;
		qcom,mdss-dsi-wr-mem-continue = <0x3c>;
		qcom,mdss-dsi-te-check-enable;
		qcom,mdss-dsi-te-pin-select = <1>;
		qcom,mdss-dsi-te-using-te-pin;
		/*qcom,ulps-enabled;*/
		qcom,mdss-dsi-bl-pmic-control-type = "bl_ctrl_wled";
		qcom,mdss-dsi-reset-sequence = <0 40>, <1 2>, <0 2>, <1 20>;

		/* below setting need to review */
		/* iris mipi mode */
		qcom,iris-mipirx-channel = <0x2>;    /*dual channel*/
		qcom,iris-mipitx-channel = <0x2>;
		qcom,iris-mipirx-dsc = <0x0>;        /*non DSC*/
		qcom,iris-mipitx-dsc = <0x0>;
		qcom,iris-mipirx-pxl-mode = <0x0>;
		qcom,iris-mipitx-pxl-mode = <0x1>;
		/* the mipitx of iris will always works at video mode.
		so the panel should be configured as video mode */
		/* need to review*/
		qcom,mdss-dsi-on-command-to-video-panel = [
                        15 01 00 00 00 00 02 53 2c
                        15 01 00 00 00 00 02 51 00
                        15 01 00 00 00 00 02 55 03
                        05 01 00 00 3f 00 01 11
                        05 01 00 00 3f 00 01 29
		];
		qcom,mdss-dsi-on-command-to-video-panel-state = "dsi_lp_mode";
		/* need to review*/
		qcom,mdss-dsi-off-command-to-video-panel = [
			05 01 00 00 00 00 01 28
                        05 01 00 00 33 00 01 6c
                        05 01 00 00 33 00 01 10
		];
		qcom,mdss-dsi-off-command-to-video-panel-state = "dsi_hs_mode";
		/* configure mipirx of iris to support command mode */
		/* need to review*/
		qcom,mdss-dsi-on-command-to-iris-mipirx = [
			15 01 00 00 01 00 02 3a 77 /* rgb_888 */
			15 01 00 00 01 00 02 35 00 /* set tearing on */
			39 01 00 00 01 00 05 2a 00 00 05 ff
			39 01 00 00 01 00 05 2b 00 00 07 ff
		];
		qcom,mdss-dsi-on-command-to-iris-mipirx-state = "dsi_hs_mode";

		/*iris out timing*/
		qcom,iris-out-panel-width = <768>;
		qcom,iris-out-panel-height = <2048>;
		qcom,iris-out-h-front-porch = <100>;
		qcom,iris-out-h-back-porch = <100>;
		qcom,iris-out-h-pulse-width = <8>;
		qcom,iris-out-v-back-porch = <11>;
		qcom,iris-out-v-front-porch = <15>;
		qcom,iris-out-v-pulse-width = <2>;

		/* iris sys */
		qcom,iris-dpll-clk = <121609600>;
		qcom,iris-dpll0 = <0xa>;
		qcom,iris-dpll1 = <0x261a01>;
		qcom,iris-dpll2 = <0xc49b>;

		/* iris mipi rx */
		qcom,mipirx-dsi-functional-program = <0x64>;
		qcom,mipirx-data-lane-timing-param = <0xff07>;

		/* iris mipi tx */
		qcom,mipitx-dsi-functional-program = <0x6204>;
		qcom,mipitx-phy-pll-ratio = <20>;
		qcom,mipitx-phy-byteclk = <96000000>;
		qcom,mipitx-hs-transmit-timeout = <0x61a800>;
		qcom,mipitx-lp-receive-timeout = <0x26>;
		qcom,mipitx-hs-lp-switching-time-count = <0x27>;
		qcom,mipitx-pll-lock-count = <0x780>;
		qcom,mipitx-clock-lane-switching-time-count = <0x38001a>;
		qcom,mipitx-lp-equivalent-byteclk = <0x5>;
		qcom,mipitx-dphy-param = <0xf080e01>;
		qcom,mipitx-data-lane-timing-param = <0xa061d02>;

		qcom,iris-delta-period-max = <62>;
		qcom,iris-delta-period-min = <4>;
	};
};
