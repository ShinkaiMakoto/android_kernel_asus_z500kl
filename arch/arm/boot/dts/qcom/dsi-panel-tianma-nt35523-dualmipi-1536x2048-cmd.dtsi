/* Copyright (c) 2015, The Linux Foundation. All rights reserved.
 *
 * This program is free software; you can redistribute it and/or modify
 * it under the terms of the GNU General Public License version 2 and
 * only version 2 as published by the Free Software Foundation.
 *
 * This program is distributed in the hope that it will be useful,
 * but WITHOUT ANY WARRANTY; without even the implied warranty of
 * MERCHANTABILITY or FITNESS FOR A PARTICULAR PURPOSE.  See the
 * GNU General Public License for more details.
 */

&mdss_mdp {
	dsi_tianma_nt35523_dualmipi_1536x2048_cmd: qcom,mdss_dsi_tianma_nt35523_dualmipi_1536x2048_cmd{
		qcom,mdss-dsi-panel-name =
			"tianma nt35523 dualmipi 1536x2048 cmd";
		qcom,mdss-dsi-panel-type = "dsi_cmd_mode";
		qcom,mdss-dsi-panel-framerate = <60>;
		qcom,mdss-dsi-virtual-channel-id = <0>;
		qcom,mdss-dsi-stream = <0>;
		qcom,mdss-dsi-panel-width = <768>;
		qcom,mdss-dsi-panel-height = <2048>;
		qcom,mdss-dsi-h-front-porch = <100>;
		qcom,mdss-dsi-h-back-porch = <64>;
		qcom,mdss-dsi-h-pulse-width = <4>;
		qcom,mdss-dsi-h-sync-skew = <0>;
		qcom,mdss-dsi-v-back-porch = <32>;
		qcom,mdss-dsi-v-front-porch = <16>;
		qcom,mdss-dsi-v-pulse-width = <2>;
		qcom,mdss-pan-physical-width-dimension = <147>;
		qcom,mdss-pan-physical-height-dimension = <197>;
		qcom,mdss-dsi-h-left-border = <0>;
		qcom,mdss-dsi-h-right-border = <0>;
		qcom,mdss-dsi-v-top-border = <0>;
		qcom,mdss-dsi-v-bottom-border = <0>;
		qcom,mdss-dsi-bpp = <24>;
		qcom,mdss-dsi-on-command = [
                        15 01 00 00 00 00 02 53 2c
                        15 01 00 00 00 00 02 51 00
                        15 01 00 00 00 00 02 55 03
                        05 01 00 00 3f 00 01 11
                        05 01 00 00 3f 00 01 29
		];
		qcom,mdss-dsi-on-command-state = "dsi_lp_mode";
		qcom,mdss-dsi-off-command = [15 01 00 00 00 00 02 28 00
			15 01 00 00 64 00 02 10 00];
		qcom,mdss-dsi-off-command-state = "dsi_hs_mode";
		qcom,mdss-dsi-color-order; /* original has no default setting */
		qcom,mdss-dsi-underflow-color = <0xff>;
		qcom,mdss-dsi-border-color = <0>;

		qcom,mdss-dsi-h-sync-pulse = <8>; /* Paddy is 0 , Xutao excel is 8 */
		qcom,mdss-dsi-traffic-mode = "non_burst_sync_event";
		qcom,mdss-dsi-bllp-eof-power-mode;
		qcom,mdss-dsi-bllp-power-mode;
		qcom,mdss-dsi-lane-0-state;
		qcom,mdss-dsi-lane-1-state;
		qcom,mdss-dsi-lane-2-state;
		qcom,mdss-dsi-lane-3-state;
		qcom,mdss-dsi-panel-timings = [c0 2c 1e 00 58 5c 22 30 22 03 04 00];
		qcom,mdss-dsi-t-clk-post = <0x3>;
		qcom,mdss-dsi-t-clk-pre = <0x24>;

		qcom,mdss-dsi-bl-min-level = <1>;
		qcom,mdss-dsi-bl-max-level = <4095>;
		qcom,mdss-dsi-dma-trigger = "trigger_sw";
		qcom,mdss-dsi-mdp-trigger = "none";
		qcom,mdss-dsi-init-delay-us = <1000>;
		qcom,mdss-dsi-te-dcs-command = <1>;
		qcom,mdss-dsi-wr-mem-start = <0x2c>;
		qcom,mdss-dsi-wr-mem-continue = <0x3c>;
		qcom,mdss-dsi-te-check-enable;
		qcom,mdss-dsi-te-pin-select = <1>;
		qcom,mdss-dsi-te-using-te-pin;
		/*qcom,ulps-enabled;*/
		qcom,mdss-dsi-bl-pmic-control-type = "bl_ctrl_wled";
		qcom,mdss-dsi-reset-sequence = <0 40>, <1 2>, <0 2>, <1 20>;

		/* below setting need to review */
		/* iris mipi mode */
		qcom,iris-mipirx-channel = <0x2>;    /*dual channel*/
		qcom,iris-mipitx-channel = <0x2>;
		qcom,iris-mipirx-dsc = <0x0>;        /*non DSC*/
		qcom,iris-mipitx-dsc = <0x0>;
		qcom,iris-mipirx-pxl-mode = <0x0>;
		qcom,iris-mipitx-pxl-mode = <0x1>;
		qcom,iris-panel-cmd-sync-wait-broadcast;
		/* the mipitx of iris will always works at video mode.
		so the panel should be configured as video mode */
		/* need to review*/
		qcom,mdss-dsi-on-command-to-video-panel = [
				29 01 00 00 00 00 06 F0 55 AA 52 08 00
				29 01 00 00 00 00 03 B1 E8 11
				29 01 00 00 00 00 03 B5 08 00
				29 01 00 00 00 00 05 BD 01 8D 20 10
				29 01 00 00 00 00 03 BC 0F 25
				29 01 00 00 00 00 04 C0 03 02 02
				29 01 00 00 00 00 06 F0 55 AA 52 08 01
				23 01 00 00 00 00 02 CE 04
				23 01 00 00 00 00 02 B3 32
				29 01 00 00 00 00 03 C3 82 82
				29 01 00 00 00 00 03 B4 0F 0F
				29 01 00 00 00 00 03 BC 4B 00
				29 01 00 00 00 00 03 BD 4B 00
				29 01 00 00 00 00 06 F0 55 AA 52 08 02
				23 01 00 00 00 00 02 B0 40
				29 01 00 00 00 00 11 D1 00 40 00 52 00 6D 00 85 00 A7 00 C7 00 E4 01 0E
				29 01 00 00 00 00 11 D2 01 34 01 70 01 9E 01 E7 02 21 02 23 02 56 02 91
				29 01 00 00 00 00 11 D3 02 B7 02 EB 03 0E 03 3A 03 55 03 79 03 8F 03 A9
				29 01 00 00 00 00 05 D4 03 C7 03 F0
				29 01 00 00 00 00 06 F0 55 AA 52 08 03
				29 01 00 00 00 00 05 B0 00 32 00 00
				29 01 00 00 00 00 08 B2 02 00 11 05 00 00 00
				29 01 00 00 00 00 08 B3 02 00 10 05 00 00 00
				29 01 00 00 00 00 08 B4 02 00 0F 05 00 00 00
				29 01 00 00 00 00 0B B6 00 00 17 05 00 00 00 00 00 00
				29 01 00 00 00 00 08 BA C6 06 00 0B 01 50 65
				29 01 00 00 00 00 08 BB C6 06 00 0A 01 50 65
				29 01 00 00 00 00 03 C4 10 00
				29 01 00 00 00 00 03 C5 00 00
				29 01 00 00 00 00 06 F0 55 AA 52 08 05
				29 01 00 00 00 00 05 B0 17 03 00 03
				29 01 00 00 00 00 07 D0 00 48 01 00 00 00
				29 01 00 00 00 00 07 D1 00 48 02 00 00 00
				29 01 00 00 00 00 04 b2 03 01 00
				29 01 00 00 00 00 05 b3 82 23 02 96
				23 01 00 00 00 00 02 E7 A9
				29 01 00 00 00 00 03 E8 11 FF
				29 01 00 00 00 00 03 EE AA 00
				29 01 00 00 00 00 06 F0 55 AA 52 08 06
				29 01 00 00 00 00 06 B0 3D 3D 3D 3D 3D
				29 01 00 00 00 00 06 B1 3D 3D 3D 08 32
				29 01 00 00 00 00 06 B2 33 10 11 12 13
				29 01 00 00 00 00 06 B3 14 15 33 03 04
				29 01 00 00 00 00 03 B4 00 3D
				29 01 00 00 00 00 06 B5 3D 3D 3D 3D 3D
				29 01 00 00 00 00 06 B6 3D 3D 3D 09 32
				29 01 00 00 00 00 06 B7 33 16 17 18 19
				29 01 00 00 00 00 06 B8 1A 1B 33 05 01
				29 01 00 00 00 00 03 B9 02 3D
				29 01 00 00 00 00 06 C0 3D 3D 3D 3D 3D
				29 01 00 00 00 00 06 C1 3D 3D 3D 09 33
				29 01 00 00 00 00 06 C2 32 19 18 17 16
				29 01 00 00 00 00 06 C3 1B 1A 33 02 01
				29 01 00 00 00 00 03 C4 05 3D
				29 01 00 00 00 00 06 C5 3D 3D 3D 3D 3D
				29 01 00 00 00 00 06 C6 3D 3D 3D 08 33
				29 01 00 00 00 00 06 C7 32 13 12 11 10
				29 01 00 00 00 00 06 C8 15 14 33 00 04
				29 01 00 00 00 00 03 C9 03 3D
				15 01 00 00 00 00 02 35 00
				15 01 00 00 00 00 02 51 00
				15 01 00 00 00 00 02 53 2C
				15 01 00 00 00 00 02 55 03
				05 01 00 00 78 00 01 11
				05 01 00 00 00 00 01 29
		];
		qcom,mdss-dsi-on-command-to-video-panel-state = "dsi_lp_mode";
		/* need to review*/
		qcom,mdss-dsi-off-command-to-video-panel = [
			05 01 00 00 00 00 01 28
			05 01 00 00 33 00 01 10
		];
		qcom,mdss-dsi-off-command-to-video-panel-state = "dsi_hs_mode";
		/* configure mipirx of iris to support command mode */
		/* need to review*/
		qcom,mdss-dsi-on-command-to-iris-mipirx = [
			15 01 00 00 01 00 02 3a 77 /* rgb_888 */
			15 01 00 00 01 00 02 35 00 /* set tearing on */
			39 01 00 00 01 00 05 2a 00 00 05 ff
			39 01 00 00 01 00 05 2b 00 00 07 ff
		];
		qcom,mdss-dsi-on-command-to-iris-mipirx-state = "dsi_hs_mode";

		/*iris out timing*/
		qcom,iris-out-panel-width = <768>;
		qcom,iris-out-panel-height = <2048>;
		qcom,iris-out-h-front-porch = <100>;
		qcom,iris-out-h-back-porch = <64>;
		qcom,iris-out-h-pulse-width = <4>;
		qcom,iris-out-v-back-porch = <32>;
		qcom,iris-out-v-front-porch = <16>;
		qcom,iris-out-v-pulse-width = <2>;

		/* iris sys */
		qcom,iris-dpll-clk = <117861120>;
		qcom,iris-dpll0 = <0xa>;
		qcom,iris-dpll1 = <0x241301>;
		qcom,iris-dpll2 = <0xd4e3bc>;

		/* iris mipi rx */
		qcom,mipirx-dsi-functional-program = <0x64>;
		qcom,mipirx-data-lane-timing-param = <0xff07>;

		/* iris mipi tx */
		qcom,mipitx-dsi-functional-program = <0x6204>;
		qcom,mipitx-phy-pll-ratio = <19>;
		qcom,mipitx-phy-byteclk = <91200000>;
		qcom,mipitx-hs-transmit-timeout = <0x5cc600>;
		qcom,mipitx-lp-receive-timeout = <0x26>;
		qcom,mipitx-hs-lp-switching-time-count = <0x27>;
		qcom,mipitx-pll-lock-count = <0x780>;
		qcom,mipitx-clock-lane-switching-time-count = <0x360019>;
		qcom,mipitx-lp-equivalent-byteclk = <0x5>;
		qcom,mipitx-dphy-param = <0xe070e01>;
		qcom,mipitx-data-lane-timing-param = <0xa051b02>;

		qcom,iris-delta-period-max = <62>;
		qcom,iris-delta-period-min = <4>;
	};
};
