
qcom,2670491_asus_c11p1615lgc_4680mah_averaged_masterslave_nov29th2016 {
	/* #2670491_Asus_C11P1615lgc_4680mAh_averaged_MasterSlave_Nov29th2016*/
	qcom,max-voltage-uv = <4380000>;
	qcom,nom-batt-capacity-mah = <4680>;
	qcom,batt-id-kohm = <51>;
	qcom,battery-beta = <3435>;
	qcom,battery-type = "2670491_asus_c11p1615lgc_4680mah_averaged_masterslave_nov29th2016";
	qcom,chg-rslow-comp-c1 = <2759991>;
	qcom,chg-rslow-comp-c2 = <3350527>;
	qcom,chg-rs-to-rslow = <1344350>;
	qcom,chg-rslow-comp-thr = <0x99>;
	qcom,checksum = <0x2A71>;
	qcom,gui-version = "PMI8950GUI - 2.0.0.16";
	qcom,fg-profile-data = [
		 05 88 53 7E 
		 1F 82 A3 7C 
		 56 83 FD 5E 
		 86 81 28 8C 
		 ED 81 BD 99 
		 A0 B7 C4 C2 
		 64 19 F8 83 
		 34 7D 38 81 
		 82 77 5C 83 
		 02 5F 8B 83 
		 E2 8E 3F 82 
		 9B 98 2A B6 
		 86 C1 58 19 
		 CA 11 47 58 
		 91 6F 30 FA 
		 6C 3F 15 44 
		 3F 41 00 00 
		 86 46 81 28 
		 07 39 00 00 
		 00 00 00 00 
		 00 00 00 00 
		 A0 71 30 71 
		 61 69 03 83 
		 5F 74 BE 61 
		 29 69 35 80 
		 AC 6D 6F 49 
		 73 6D 4F A2 
		 23 0E 61 7D 
		 5E A0 71 0C 
		 28 00 FF 36 
		 F0 11 30 03 
		 00 00 00 0C 
	];
};
