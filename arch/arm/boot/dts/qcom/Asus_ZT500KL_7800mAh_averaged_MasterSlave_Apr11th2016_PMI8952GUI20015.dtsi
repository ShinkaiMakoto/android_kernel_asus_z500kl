
qcom,2342476_asus_zt500kl_7800mah_averaged_masterslave_apr11th2016 {
	/* #2342476_Asus_ZT500KL_7800mAh_averaged_MasterSlave_Apr11th2016*/
	qcom,max-voltage-uv = <4400000>;
	qcom,nom-batt-capacity-mah = <7800>;
	qcom,batt-id-kohm = <51>;
	qcom,battery-beta = <3435>;
	qcom,battery-type = "2342476_asus_zt500kl_7800mah_averaged_masterslave_apr11th2016";
	qcom,chg-rslow-comp-c1 = <3602078>;
	qcom,chg-rslow-comp-c2 = <6293445>;
	qcom,chg-rs-to-rslow = <735844>;
	qcom,chg-rslow-comp-thr = <0xB7>;
	qcom,checksum = <0x678A>;
	qcom,gui-version = "PMI8950GUI - 2.0.0.15";
	qcom,fg-profile-data = [
		 ED 83 41 7D 
		 6B 81 D2 77 
		 5B 83 10 65 
		 7F 82 4D 8D 
		 45 82 96 98 
		 68 B6 06 C2 
		 58 13 F7 83 
		 3F 7D 5B 81 
		 A7 77 60 83 
		 2B 5C 7A 83 
		 69 8F 4A 82 
		 FD 99 6C BD 
		 9E CA 54 0D 
		 B1 1E C4 52 
		 14 70 1C FC 
		 53 44 02 3E 
		 27 40 00 00 
		 3A 46 D9 33 
		 FD 36 00 00 
		 00 00 00 00 
		 00 00 00 00 
		 02 6A E2 69 
		 54 6B 45 89 
		 E7 75 AD 68 
		 8C 67 87 80 
		 E4 75 AA 68 
		 89 4C F1 CA 
		 0B 18 60 F5 
		 5D A0 71 0C 
		 28 00 FF 36 
		 F0 11 30 03 
		 00 00 00 0C 
	];
};
